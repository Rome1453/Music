#include <U8glib.h>
#include <Wire.h>
#include <Adafruit_GFX.h>
#include <Adafruit_SSD1306.h>
const unsigned char PROGMEM ri[] = {
0x00,0x00,0x00,0x00,0x00,0x00,0x00,0x00,0x00,0x00,0x00,0x00,0x00,0x00,0x00,0x00,
0x00,0x00,0x00,0x00,0x00,0x00,0x00,0x00,0x00,0x00,0x00,0x00,0x00,0x00,0x00,0x00,
0x00,0x00,0x00,0x00,0x00,0x00,0x00,0x00,0x00,0x00,0x00,0x00,0x00,0x00,0x00,0x00,
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0x00,0x00,0x00,0x00,0x00,0x00,0x00,0x00,0x00,0x00,0x00,0x00,0x00,0x00,0x00,0x00
};                  //OLED显示图片
#define INTERVAL_LCD 20               //定义OLED刷新时间间隔  
unsigned long lcd_time = millis();                   //OLED刷新时间计时器
U8GLIB_SSD1306_128X64 u8g(U8G_I2C_OPT_NONE);       //设置OLED型号  
#define setFont_L u8g.setFont(u8g_font_7x13)
#define setFont_M u8g.setFont(u8g_font_fixed_v0r)
#define setFont_S u8g.setFont(u8g_font_fixed_v0r)
#define setFont_SS u8g.setFont(u8g_font_fub25n)      //设置字体大小

#define OLED_RESET -1
Adafruit_SSD1306 display(OLED_RESET);

#define F0 -1
#define F1 350
#define F2 393
#define F3 441
#define F4 466
#define F5 523
#define F6 587
#define F7 659

#define FL1 175
#define FL2 196
#define FL3 221
#define FL4 234
#define FL5 262
#define FL6 294
#define FL7 330

#define FH1 700
#define FH2 786
#define FH3 882
#define FH4 935
#define FH5 1049
#define FH6 1178
#define FH7 1322           //定义音频

#define WHOLE 1
#define HALF 0.5
#define QUARTER 0.25
#define EIGHTH 0.125
#define SIXTEENTH 0.0625

int tuneA[] =
{
FH3,FH2,FH1,F0,F5,F3,F6,F0,F4,F0,
FH2,FH1,F7,F0,F6,F5,FH3,F0,
FH3,FH5,F0,FH4,F0,FH3,F0,FH2,F0,FH3,F0,FH4,F0,
FH4,F0,FH3,F0,FH3,F0,FH2,F0,FH2,F0,FH1,F0,
};                //音乐部分

float durationA[] =
{
0.5,0.5,1,1,1,1,1,1,0.5,1,
0.5,0.5,1,1,1,1,1,1,
1,1,0.5,1,0.0625,1,0.0625,1,0.0625,1,0.0625,1,1,
0.5,1,1,0.0625,1,0.0625,1,0.0625,1,0.0625,1,0.0625,
};                  //音乐节拍

int length;
int toneA = 7;
int state = 0;
int Intensity = 0;
int button=6;
int i=9;
int sensor =2;
int m=0;
boolean buttonstate =true;

void load(void) {
  display.clearDisplay();
  display.setTextSize(1);      //字体大小
  display.setTextColor(WHITE);
  display.setCursor(25, 20);
  display.println("Loading");
  delay(3000);
  display.display();
}

void setup()
{
  pinMode(toneA, OUTPUT); 
  pinMode(button,INPUT_PULLUP);     //设置引脚为输入上拉模式
  pinMode(9, OUTPUT); 
  pinMode(10, OUTPUT); 
  pinMode(11, OUTPUT); 
  length = sizeof(tuneA) / sizeof(tuneA[0]);        //计算长度，用于下方for循环
  Serial.begin(115200);   
  pinMode(sensor,INPUT);
  
  display.begin(SSD1306_SWITCHCAPVCC, 0x3C); 
  load();
  display.clearDisplay();  //清理屏幕和缓存区
}

void loop()
{
  int l=analogRead(A3);         //光敏电阻感受光照强度
  int val=digitalRead(sensor);
  while(1){
    if(m>=2)
    break;
    if(l>=800){
    Serial.println(l);
    delay(3000);
    m++;}
    }             //该循环为计时用(实验用计时为6秒)

  char ch='2';
  u8g.firstPage(); 
  do{
  setFont_M;
  u8g.drawBitmapP(0, 0, 16, 64, ri);
  }while (u8g.nextPage());      //OLED显示字体
  
  if(val==1)             //如果有人则播放音乐
  for (int x = 0; x < length; x++) 
  {
  Serial.println(val);
  delay(10);
  if(digitalRead(button)==HIGH&&buttonstate==true){
    buttonstate=!buttonstate;
  }
  else if(digitalRead(button)==LOW&&buttonstate==false)
  buttonstate=!buttonstate;                               //判断条件已确定是否改变buttonstate状态
  if(buttonstate==true){
    tone(toneA, tuneA[x]);
    digitalWrite(i,HIGH); 
    delay(400 * durationA[x]); 
    digitalWrite(i,LOW);
    noTone(toneA);           //tone函数播放音乐
    i++;
    if(i==12)
    i-=3;           //控制LED灯光使其循环闪烁
    }
  else
  x=x-1;        //从断点处暂停
}
  delay(10000);
}
